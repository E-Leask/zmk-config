#include <dt-bindings/zmk/matrix_transform.h> // Put this with the other includes at the top of your overlay
#include "hipfire.dtsi"

/// {
//    kscan0: kscan0 {
//        row-gpios
//            = <&pro_micro 10 (GPIO_ACTIVE_HIGH | GPIO_PULL_DOWN)>
//            , <&pro_micro 16 (GPIO_ACTIVE_HIGH | GPIO_PULL_DOWN)>
//            ;
//    };
//};
