#include <dt-bindings/zmk/matrix_transform.h> // Put this with the other includes at the top of your overlay
#include "hipfire.dtsi"

/ {
    kscan0: kscan0 {
        row-gpios
            = <&pro_micro 10 (GPIO_ACTIVE_HIGH | GPIO_PULL_DOWN)>
            ;
    };
};


    &default_transform { // Offset of 3 because the left side has 3 columns
    col-offset = <3>;
};

//// Bluetooth communication configuration
//ble_radio_ctrl: ble_radio_ctrl {
//    compatible = "zmk,split-bluetooth";
//    status = "okay";
//};