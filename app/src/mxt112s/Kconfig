## app/src/mxt112s/Kconfig
```kconfig
config CONFIG_ZMK_MXT112S_POINTER
    bool "Enable mXT112S Touchscreen Pointer Support"
    default y
    depends on I2C
    help
      Enables pointer support for the mXT112S touchscreen controller.
```

## boards/shields/hipfire/Kconfig.shield
```kconfig
config SHIELD_HIPFIRE_LEFT
    def_bool $(shields_list_contains,hipfire_left)

config SHIELD_HIPFIRE_RIGHT
    def_bool $(shields_list_contains,hipfire_right)
```

## config/boards/shields/hipfire/Kconfig.defconfig
```kconfig
if SHIELD_HIPFIRE_LEFT

config ZMK_KEYBOARD_NAME
    default "hipfire"

config ZMK_SPLIT_ROLE_CENTRAL
    default y

endif

if SHIELD_HIPFIRE_LEFT || SHIELD_HIPFIRE_RIGHT

config ZMK_SPLIT
    default y

endif
```
