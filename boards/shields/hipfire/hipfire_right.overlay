#include <dt-bindings/zmk/matrix_transform.h> // Put this with the other includes at the top of your overlay
#include "hipfire.dtsi"

    &default_transform { // Offset of 3 because the left side has 3 columns
    col-offset = <0>;
    };
    
&i2c0 {
    mxt112s@4a {
        compatible = "microchip,mxt112s";
        reg = <0x4a>;
    };
};

    &kscan0 {
	          col-gpios
		        = <&pro_micro 10 GPIO_ACTIVE_HIGH>   
            , <&pro_micro 18 GPIO_ACTIVE_HIGH>
            , <&pro_micro 8 GPIO_ACTIVE_HIGH>
            , <&pro_micro 5 GPIO_ACTIVE_HIGH>
            , <&pro_micro 19 GPIO_ACTIVE_HIGH>
            , <&pro_micro 9 GPIO_ACTIVE_HIGH>
            , <&pro_micro 4 GPIO_ACTIVE_HIGH>
            , <&pro_micro 20 GPIO_ACTIVE_HIGH>
            , <&pro_micro 3 GPIO_ACTIVE_HIGH>
            ;

            row-gpios                 
            = 
            <&pro_micro 7 (GPIO_ACTIVE_HIGH | GPIO_PULL_DOWN)>
            ,  <&pro_micro 6 (GPIO_ACTIVE_HIGH | GPIO_PULL_DOWN)>
            , <&pro_micro 15 (GPIO_ACTIVE_HIGH | GPIO_PULL_DOWN)>
            , <&pro_micro 14 (GPIO_ACTIVE_HIGH | GPIO_PULL_DOWN)>
            , <&pro_micro 16 (GPIO_ACTIVE_HIGH | GPIO_PULL_DOWN)>
            ;
    };
